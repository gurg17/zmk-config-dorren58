## boards/shields/dorren58/Kconfig.defconfig
```kconfig
if SHIELD_DORREN58_LEFT

# Name must be less than 16 characters long!
config ZMK_KEYBOARD_NAME
    default "Dorren58"

config ZMK_SPLIT_ROLE_CENTRAL
    default y

endif

if SHIELD_DORREN58_LEFT || SHIELD_DORREN58_RIGHT

config ZMK_SPLIT
    default y

endif
```

## config/boards/shields/dorren58/Kconfig.shield
```kconfig
# No whitespace after the comma or in your part name!
config SHIELD_DORREN58_LEFT
    def_bool $(shields_list_contains,dorren58_left)

# No whitespace after the comma or in your part name!
config SHIELD_DORREN58_RIGHT
    def_bool $(shields_list_contains,dorren58_right)
```
